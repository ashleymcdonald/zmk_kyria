
#include "sv1.dts"

/***
/{


	kscan0: kscan {
		compatible = "zmk,kscan-gpio-matrix";
		label = "KSCAN";

		diode-direction = "col2row";
		row-gpios
			= <&gpio0 22 (GPIO_ACTIVE_HIGH | GPIO_PULL_DOWN)>
			, <&gpio1  0 (GPIO_ACTIVE_HIGH | GPIO_PULL_DOWN)>
			, <&gpio1  3 (GPIO_ACTIVE_HIGH | GPIO_PULL_DOWN)>
			, <&gpio1  1 (GPIO_ACTIVE_HIGH | GPIO_PULL_DOWN)>
			;

		col-gpios
			= <&gpio0 19 GPIO_ACTIVE_HIGH>
			, <&gpio0 21 GPIO_ACTIVE_HIGH>
			, <&gpio0 23 GPIO_ACTIVE_HIGH>
			, <&gpio0 12 GPIO_ACTIVE_HIGH>
			, <&gpio1  9 GPIO_ACTIVE_HIGH>
			, <&gpio0  7 GPIO_ACTIVE_HIGH>
			;
	};

};
******/


&kscan0 {
	row-gpios
	    = <&pro_micro 19 (GPIO_ACTIVE_HIGH | GPIO_PULL_DOWN)>
		, <&pro_micro 18 (GPIO_ACTIVE_HIGH | GPIO_PULL_DOWN)>
		, <&pro_micro 15 (GPIO_ACTIVE_HIGH | GPIO_PULL_DOWN)>
		, <&pro_micro 14 (GPIO_ACTIVE_HIGH | GPIO_PULL_DOWN)>
		;
	col-gpios
		= <&pro_micro 4 GPIO_ACTIVE_HIGH>
		, <&pro_micro 5 GPIO_ACTIVE_HIGH>
		, <&pro_micro 6 GPIO_ACTIVE_HIGH>
		, <&pro_micro 7 GPIO_ACTIVE_HIGH>
		, <&pro_micro 8 GPIO_ACTIVE_HIGH>
		, <&pro_micro 9 GPIO_ACTIVE_HIGH>
		, <&pro_micro 10 GPIO_ACTIVE_HIGH>
		, <&pro_micro 16 GPIO_ACTIVE_HIGH>
		;
};

&left_encoder {
	status = "okay";
};